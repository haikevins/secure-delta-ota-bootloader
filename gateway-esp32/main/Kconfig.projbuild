## gateway-esp32/main/Kconfig.projbuild
```kconfig
menu "Secure Delta OTA Gateway"

config SDOTA_STM32_UART_NUM
    int "STM32 UART controller"
    range 1 2
    default 2
    help
        UART0 is reserved for ESP-IDF console. UART2 is the default on ESP32.

config SDOTA_STM32_UART_TX_GPIO
    int "ESP32 TX GPIO -> STM32 PA10"
    range 0 39
    default 17

config SDOTA_STM32_UART_RX_GPIO
    int "ESP32 RX GPIO <- STM32 PA9"
    range 0 39
    default 16

config SDOTA_GATEWAY_TASK_STACK_SIZE
    int "Gateway worker task stack size (bytes)"
    range 8192 32768
    default 16384
    help
        Stack for the dedicated MQTT orchestration + HTTPS + UART OTA worker.

config SDOTA_AUTORUN
    bool "Run MQTT orchestration on boot"
    default y

config SDOTA_SINGLE_SHOT
    bool "Process one MQTT update command then report a terminal result"
    default n
    help
        Intended mainly for deterministic hardware tests. Production normally
        keeps this disabled so the gateway waits for future MQTT commands.

config SDOTA_WIFI_SSID
    string "Wi-Fi SSID"
    default ""

config SDOTA_WIFI_PASSWORD
    string "Wi-Fi password"
    default ""

config SDOTA_MQTT_URI
    string "MQTT broker URI"
    default ""
    help
        Production operation requires mqtts:// with server verification.

config SDOTA_MQTT_CLIENT_ID
    string "MQTT client ID"
    default "sdota-bluepill-001"

config SDOTA_MQTT_TOPIC_BASE
    string "MQTT topic base"
    default "sdota"

config SDOTA_MQTT_DEVICE_ID
    string "MQTT device ID"
    default "bluepill-001"

config SDOTA_MQTT_USERNAME
    string "MQTT username (optional)"
    default ""

config SDOTA_MQTT_PASSWORD
    string "MQTT password (optional)"
    default ""

config SDOTA_WIFI_TIMEOUT_MS
    int "Wi-Fi connection timeout (ms)"
    range 1000 120000
    default 30000

config SDOTA_SNTP_TIMEOUT_MS
    int "SNTP synchronization timeout (ms)"
    range 1000 120000
    default 20000

config SDOTA_HTTPS_TIMEOUT_MS
    int "HTTPS inactivity/connection timeout (ms)"
    range 1000 120000
    default 15000

config SDOTA_MQTT_READY_TIMEOUT_MS
    int "MQTT connect + subscribe timeout (ms)"
    range 1000 120000
    default 30000

config SDOTA_MQTT_COMMAND_TIMEOUT_MS
    int "Single-shot MQTT command timeout (ms; 0 waits forever)"
    range 0 600000
    default 0

endmenu
```
